## so3/fs/Kconfig
```kconfig
menu "Filesystems"

config FS_FAT
        bool "FAT Filesystem"
        depends on MMC || RAMDEV

config FAT_WITH_SYMLINK
        bool "Enable simulated support to symlink with FAT (FAT_BPJ)"
        depends on FS_FAT

choice
  prompt "Location of rootfs if any"
	
	config ROOTFS_NONE
    	bool "No Root filesystem"
	
	config ROOTFS_MMC
    	bool "Root filesystem in MMC"
		select MMC
	
	config ROOTFS_RAMDEV
		bool "Root filesystem in RAM (ramdev device)"
		depends on MMU
		select RAMDEV
   
endchoice

endmenu
        
```
